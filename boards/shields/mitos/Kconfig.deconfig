## boards/shields/mitos/Kconfig.deconfig
```kconfig
config SHIELD_MITOS_LEFT
    def_bool $(shields_list_contains,mitos_left)

config SHIELD_MITOS_RIGHT
    def_bool $(shields_list_contains,mitos_right)
```

## boards/shields/mitos/Kconfig.shield
```kconfig
if SHIELD_MITOS_LEFT

config ZMK_KEYBOARD_NAME
    default "MITOS"

config ZMK_SPLIT_ROLE_CENTRAL
    default y

endif

if SHIELD_MITOS_LEFT || SHIELD_MITOS_RIGHT

config ZMK_SPLIT
    default y

endif
```
